## livekit-examples/robotics-video-inference-bridge/edge-embedded-client/main/Kconfig.projbuild
```kconfig
menu "LiveKit Example"

    config LK_EXAMPLE_CODEC_BOARD_TYPE
        string "Codec board type"
        default "ESP32_P4_DEV_V14"
        help
            The model of dev board you are using. See board_cfg.txt from the codec
            board component for a list of supported boards.

    menu "Video Settings"
        config LK_EXAMPLE_VIDEO_WIDTH
            int "Video width"
            default 800
            range 320 1920
            help
                Width of the video stream in pixels.

        config LK_EXAMPLE_VIDEO_HEIGHT
            int "Video height"
            default 640
            range 240 1080
            help
                Height of the video stream in pixels.

        config LK_EXAMPLE_VIDEO_FPS
            int "Video frame rate"
            default 15
            range 5 30
            help
                Target frame rate for video streaming.
    endmenu

    choice LK_EXAMPLE_CONNECTION_METHOD
        prompt "Choose room connection method"
        help
            Choose how to connect to the room in the example.

        config LK_EXAMPLE_USE_SANDBOX
            bool "Sandbox token"
            help
                Use a sandbox token server for room authentication.

        config LK_EXAMPLE_USE_PREGENERATED
            bool "Pre-generated token"
            help
                Use a pre-generated token and server URL for room connection.
    endchoice

    config LK_EXAMPLE_SERVER_URL
        depends on LK_EXAMPLE_USE_PREGENERATED
        string "Server URL"
        default "wss://your_project.livekit.cloud"
        help
            The server URL to use for room connection.
    config LK_EXAMPLE_TOKEN
        depends on LK_EXAMPLE_USE_PREGENERATED
        string "Token"
        default "your_token"
        help
            The token to use for room connection.

    config LK_EXAMPLE_SANDBOX_ID
        depends on LK_EXAMPLE_USE_SANDBOX
        string "Sandbox ID"
        help
            The ID of the sandbox token server to use.
    config LK_EXAMPLE_ROOM_NAME
        depends on LK_EXAMPLE_USE_SANDBOX
        string "Room name (optional)"
        default "edge-cv"
        help
            Specific room name sandbox tokens will be generated with.
    config LK_EXAMPLE_PARTICIPANT_NAME
        depends on LK_EXAMPLE_USE_SANDBOX
        string "Participant name (optional)"
        default "edge-embedded-client"
        help
            Specific participant name sandbox tokens will be generated with.

endmenu
```

## livekit-examples/robotics-video-inference-bridge/edge-embedded-client/sdkconfig.defaults
```kconfig
# Enable SPIRAM
CONFIG_SPIRAM=y

# Enable GDBStub
CONFIG_ESP_SYSTEM_PANIC_GDBSTUB=y

# Enable FreeRTOS trace
CONFIG_FREERTOS_USE_TRACE_FACILITY=y
CONFIG_FREERTOS_VTASKLIST_INCLUDE_COREID=y
CONFIG_FREERTOS_GENERATE_RUN_TIME_STATS=y

# Support 2 SNTP
CONFIG_LWIP_SNTP_MAX_SERVERS=2

# Enable DTLS SRTP
CONFIG_MBEDTLS_SSL_PROTO_DTLS=y
CONFIG_MBEDTLS_SSL_DTLS_SRTP=y
CONFIG_MBEDTLS_X509_CREATE_C=y

# Use new I2C master
CONFIG_CODEC_I2C_BACKWARD_COMPATIBLE=n

# Enable experimental features
CONFIG_IDF_EXPERIMENTAL_FEATURES=y

CONFIG_PARTITION_TABLE_SINGLE_APP_LARGE=y

CONFIG_VIDEO_DECODER_SW_H264_SUPPORT=n
CONFIG_VIDEO_ENCODER_SW_H264_SUPPORT=n
```
